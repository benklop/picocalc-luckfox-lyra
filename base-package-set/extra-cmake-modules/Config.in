## base-package-set/extra-cmake-modules/Config.in
```kconfig
config BR2_PACKAGE_EXTRA_CMAKE_MODULES
	bool "extra-cmake-modules"
	help
	  This package corresponds to the extra CMake modules,

	  https://api.kde.org/frameworks/extra-cmake-modules/html/index.html
```

## base-package-set/garglk/Config.in
```kconfig
config BR2_PACKAGE_GARGLK
    bool "garglk"
    select BR2_PACKAGE_QT5
	  select BR2_PACKAGE_QT5BASE
    select BR2_PACKAGE_QT5BASE_GUI
    select BR2_PACKAGE_QT5BASE_WIDGETS
    select BR2_PACKAGE_QT5BASE_FONTCONFIG
    select BR2_PACKAGE_FONTCONFIG
    select BR2_PACKAGE_FREETYPE
    select BR2_PACKAGE_JPEG_TURBO
    select BR2_PACKAGE_LIBPNG
    select BR2_PACKAGE_ZLIB_NG
    select BR2_PACKAGE_SDL2
    select BR2_PACKAGE_SDL2_MIXER

    help
      Gargoyle is an interpreter for interactive fiction games.
```

## base-package-set/notmuch/Config.in
```kconfig
config BR2_PACKAGE_NOTMUCH
	bool "notmuch"
	select BR2_PACKAGE_LIBTALLOC
	select BR2_PACKAGE_LIBUNWIND
	select BR2_PACKAGE_LIBXAPIAN
	select BR2_PACKAGE_GMIME
	help
	  Mail indexer
```

## base-package-set/rtl8188fu/Config.in
```kconfig
config BR2_PACKAGE_RTL8188FU
	bool "rtl8188fu"
	depends on !BR2_s390x
	depends on BR2_LINUX_KERNEL
	help
	  A standalone driver for the RTL8188FU USB Wi-Fi adapter.
	  This driver provides support for Realtek RTL8188FU chipset 
	  USB WiFi dongles.

	  Make sure your target kernel has the CONFIG_WIRELESS_EXT
	  config option enabled.

	  Note: this package needs a firmware loading mechanism to load
	  the binary blob for the chip to work.

	  https://github.com/kelebek333/rtl8188fu

comment "rtl8188fu needs a Linux kernel to be built"
	depends on !BR2_s390x
	depends on !BR2_LINUX_KERNEL
```

## base/buildroot/configs/rockchip_rk3506_picocalc_luckfox_defconfig
```kconfig
BR2_BACKUP_SITE=""
BR2_FORCE_HOST_BUILD=y
BR2_GENERATE_LOCALE="en_US.UTF-8"
BR2_GNU_MIRROR="https://mirrors.ustc.edu.cn/gnu"
BR2_LINUX_KERNEL=y
BR2_LINUX_KERNEL_CUSTOM_LOCAL=y
BR2_LINUX_KERNEL_CUSTOM_LOCAL_LOCATION="$(TOPDIR)/../kernel"
BR2_LINUX_KERNEL_DEFCONFIG="picocalc_rk3506_luckfox"
BR2_LV_DRM_USE_RGA=y
BR2_LV_USE_DEMO_MUSIC=y
BR2_LV_USE_LINUX_DRM=y
BR2_PACKAGE_ALSA_UCM_CONF=y
BR2_PACKAGE_ALSA_UTILS=y
BR2_PACKAGE_ALSA_UTILS_ALSACONF=y
BR2_PACKAGE_ALSA_UTILS_AMIXER=y
BR2_PACKAGE_ALSA_UTILS_APLAY=y
BR2_PACKAGE_ANDROID_ADBD=y
BR2_PACKAGE_BUSYBOX_CONFIG_FRAGMENT_FILES="board/rockchip/common/base/busybox.fragment"
BR2_PACKAGE_BUSYBOX_SHOW_OTHERS=y
BR2_PACKAGE_CAN_UTILS=y
BR2_PACKAGE_CRDA=y
BR2_PACKAGE_DHCPCD=y
BR2_PACKAGE_DIRECTFB=y
# BR2_PACKAGE_DIRECTFB_DEBUG_SUPPORT is not set
BR2_PACKAGE_DIRECTFB_DITHER_RGB16=y
# BR2_PACKAGE_DIRECTFB_GIF is not set
# BR2_PACKAGE_DIRECTFB_JPEG is not set
# BR2_PACKAGE_DIRECTFB_PNG is not set
# BR2_PACKAGE_DIRECTFB_PS2MOUSE is not set
# BR2_PACKAGE_DIRECTFB_SERIALMOUSE is not set
# BR2_PACKAGE_DIRECTFB_SVG is not set
# BR2_PACKAGE_DIRECTFB_TSLIB is not set
BR2_PACKAGE_DOSFSTOOLS=y
BR2_PACKAGE_DOSFSTOOLS_FATLABEL=y
BR2_PACKAGE_DOSFSTOOLS_FSCK_FAT=y
BR2_PACKAGE_DOSFSTOOLS_MKFS_FAT=y
BR2_PACKAGE_E2FSPROGS=y
BR2_PACKAGE_E2FSPROGS_RESIZE2FS=y
BR2_PACKAGE_EUDEV_RULES_GEN=y
BR2_PACKAGE_EVTEST=y
BR2_PACKAGE_FATRESIZE=y
BR2_PACKAGE_FBV=y
BR2_PACKAGE_FFMPEG=y
BR2_PACKAGE_FFMPEG_FFPLAY=y
BR2_PACKAGE_HOSTAPD=y
BR2_PACKAGE_HOST_ENVIRONMENT_SETUP=y
BR2_PACKAGE_HOST_LINUX_HEADERS_CUSTOM_6_1=y
BR2_PACKAGE_HOST_NTFS_3G=y
BR2_PACKAGE_HOST_PYTHON3=y
BR2_PACKAGE_HOST_PYTHON3_SSL=y
BR2_PACKAGE_I2C_TOOLS=y
BR2_PACKAGE_INPUT_EVENT_DAEMON=y
BR2_PACKAGE_IPERF3=y
BR2_PACKAGE_IPROUTE2=y
BR2_PACKAGE_IW=y
BR2_PACKAGE_KIWIX_TOOLS=y
BR2_PACKAGE_LIBARCHIVE=y
BR2_PACKAGE_LIBCAP=y
BR2_PACKAGE_LIBEVDEV=y
BR2_PACKAGE_LIBJPEG=y
BR2_PACKAGE_LIBMAD=y
BR2_PACKAGE_LIBOPENSSL_BIN=y
BR2_PACKAGE_LIBSVG_CAIRO=y
BR2_PACKAGE_LIBXML2=y
BR2_PACKAGE_LSHW=y
BR2_PACKAGE_LVGL=y
BR2_PACKAGE_LVGL_VERSION_9=y
BR2_PACKAGE_MC=y
BR2_PACKAGE_MHZ=y
BR2_PACKAGE_MTD=y
BR2_PACKAGE_NANO=y
BR2_PACKAGE_OPENSSH=y
BR2_PACKAGE_OPENSSH_GEN_KEYS=y
BR2_PACKAGE_PHYTOOL=y
BR2_PACKAGE_PM_UTILS=y
BR2_PACKAGE_PYTHON3=y
BR2_PACKAGE_PYTHON3_SSL=y
BR2_PACKAGE_PYTHON_AIOHTTP=y
BR2_PACKAGE_PYTHON_CANOPEN=y
BR2_PACKAGE_PYTHON_CLICK=y
BR2_PACKAGE_PYTHON_ITSDANGEROUS=y
BR2_PACKAGE_PYTHON_JINJA2=y
BR2_PACKAGE_PYTHON_PERIPHERY=y
BR2_PACKAGE_PYTHON_PILLOW=y
BR2_PACKAGE_PYTHON_SERIAL=y
BR2_PACKAGE_PYTHON_SETUPTOOLS=y
BR2_PACKAGE_PYTHON_SMBUS_CFFI=y
BR2_PACKAGE_PYTHON_SPIDEV=y
BR2_PACKAGE_PYTHON_WERKZEUG=y
BR2_PACKAGE_RIPGREP=y
BR2_PACKAGE_RK3506=y
BR2_PACKAGE_RKSCRIPT=y
BR2_PACKAGE_RKTOOLKIT=y
BR2_PACKAGE_RKWIFIBT_APP=y
BR2_PACKAGE_ROCKCHIP=y
BR2_PACKAGE_ROCKCHIP_ALSA_CONFIG=y
BR2_PACKAGE_ROCKCHIP_RGA=y
BR2_PACKAGE_ROCKCHIP_TEST=y
BR2_PACKAGE_RTL8XXXU=y
BR2_PACKAGE_SDL2_DIRECTFB=y
BR2_PACKAGE_SDL2_GFX=y
BR2_PACKAGE_SDL2_IMAGE=y
BR2_PACKAGE_SDL2_MIXER=y
BR2_PACKAGE_SDL2_NET=y
BR2_PACKAGE_SDL2_TTF=y
BR2_PACKAGE_SL=y
BR2_PACKAGE_TMUX=y
BR2_PACKAGE_USBMOUNT=y
BR2_PACKAGE_UTIL_LINUX_AGETTY=y
BR2_PACKAGE_UTIL_LINUX_MOUNT=y
BR2_PACKAGE_VIM=y
BR2_PACKAGE_W3M=y
BR2_PACKAGE_WIRELESS_TOOLS=y
BR2_PACKAGE_WIRELESS_TOOLS_LIB=y

BR2_PACKAGE_GLKCLI=y
BR2_PACKAGE_GLKTERM=y
BR2_PACKAGE_GLKTERM_ADVSYS=y
BR2_PACKAGE_GLKTERM_AGILITY=y
BR2_PACKAGE_GLKTERM_ALAN2=y
BR2_PACKAGE_GLKTERM_ALAN3=y
BR2_PACKAGE_GLKTERM_BOCFEL=y
BR2_PACKAGE_GLKTERM_GLULXE=y
BR2_PACKAGE_GLKTERM_GIT=y
BR2_PACKAGE_GLKTERM_HUGO=y
BR2_PACKAGE_GLKTERM_JACL=y
BR2_PACKAGE_GLKTERM_LEVEL9=y
BR2_PACKAGE_GLKTERM_MAGNETIC=y
BR2_PACKAGE_GLKTERM_PLUS=y
BR2_PACKAGE_GLKTERM_SCARE=y
BR2_PACKAGE_GLKTERM_SCOTT=y
BR2_PACKAGE_GLKTERM_TADS=y
BR2_PACKAGE_GLKTERM_TAYLOR=y

# BR2_PREFER_ROCKCHIP_RGA is not set
BR2_PRIMARY_SITE="https://sources.buildroot.net"
BR2_ROCKCHIP_ALSA_CONFIG_INSTALL_INIT_SCRIPT=y
BR2_ROOTFS_DEVICE_CREATION_DYNAMIC_EUDEV=y
BR2_ROOTFS_MERGED_USR=y
BR2_ROOTFS_OVERLAY="board/rockchip/rk3506/picocalc-overlay/"
BR2_ROOTFS_POST_BUILD_SCRIPT="board/rockchip/common/post-build.sh board/rockchip/rk3506/post-build-picocalc.sh"
BR2_ROOTFS_PRE_BUILD_SCRIPT="board/rockchip/rk3506/pre-build-picocalc.sh"
BR2_TARGET_GENERIC_HOSTNAME="picocalc"
BR2_TARGET_GENERIC_ISSUE="Welcome to PicoCalc [root:picocalc]"
# BR2_TARGET_GENERIC_REMOUNT_ROOTFS_RW is not set
BR2_TARGET_GENERIC_ROOT_PASSWD="picocalc"
BR2_TARGET_ROOTFS_EXT2=y
BR2_TARGET_ROOTFS_EXT2_4=y
BR2_TARGET_ROOTFS_EXT2_SIZE="512M"
# BR2_TARGET_ROOTFS_TAR is not set
BR2_TARGET_SERIAL_SHELL_GETTY=y
BR2_TIME_BITS_64=y
BR2_TOOLCHAIN_BUILDROOT_CXX=y
BR2_arm=y
BR2_cortex_a7=y

BR2_PACKAGE_ALSA_UTILS=y
BR2_PACKAGE_ALSA_LIB_PCM=y
BR2_PACKAGE_ALSA_UTILS_SPEAKER_TEST=y

BR2_PACKAGE_WGET=y
```

## base/buildroot/package/ceni/Config.in
```kconfig
config BR2_PACKAGE_CENI
	bool "ceni"
	depends on BR2_PACKAGE_PERL
	select BR2_PACKAGE_PERL_CURSES_UI
	select BR2_PACKAGE_PERL_EXPECT
	select BR2_PACKAGE_PERL_TERM_READKEY
	select BR2_PACKAGE_PERL_IO_TTY
	select BR2_PACKAGE_IFUPDOWN_SCRIPTS
	select BR2_PACKAGE_WPA_SUPPLICANT
	help
	  A Curses user interface for configuring network interfaces with ifupdown.
	  Ceni can manage basic network interface ifupdown configuration stanzas for
	  ethernet and wireless devices.

	  https://github.com/fullstory-morgue/ceni

comment "ceni needs Perl"
	depends on !BR2_PACKAGE_PERL
```

## base/buildroot/package/chessboard/Config.in
```kconfig
config BR2_PACKAGE_CHESSBOARD
	bool "chessboard"
  select BR2_PACKAGE_NCURSES
  select BR2_PACKAGE_SDL2
  select BR2_PACKAGE_SDL2_TTF
  select BR2_PACKAGE_SDL2_IMAGE
  select BR2_PACKAGE_YAML_CPP

  help
    Chessboard frontend for GNUChess using SDL or ncurses
    https://github.com/hpsaturn/chessboard.git
```

## base/buildroot/package/cmatrix/Config.in
```kconfig
config BR2_PACKAGE_CMATRIX
	bool "cmatrix"
        select BR2_PACKAGE_NCURSES
	help
          Matrix like effect in your terminal 

          https://github.com/abishekvashok/cmatrix
```

## base/buildroot/package/fcitx-fbterm/Config.in
```kconfig
config BR2_PACKAGE_FCITX_FBTERM
	bool "fcitx-fbterm"
	depends on BR2_PACKAGE_FCITX
	help
          Fbterm support for fcitx

	  https://github.com/fcitx/fcitx-fbterm
```

## base/buildroot/package/fcitx/Config.in
```kconfig
config BR2_PACKAGE_FCITX
	bool "fcitx"
	depends on BR2_PACKAGE_DBUS
        select BR2_PACKAGE_HOST_FCITX_TOOLS
	help
          A Flexible Input Method Framework

	  https://github.com/fcitx/fcitx
```

## base/buildroot/package/glkcli/Config.in
```kconfig
config BR2_PACKAGE_GLKCLI
	bool "glkcli"
	depends on BR2_PACKAGE_GLKTERM
	depends on BR2_INSTALL_LIBSTDCPP
	depends on BR2_TOOLCHAIN_HAS_THREADS
	depends on BR2_USE_WCHAR
	select BR2_PACKAGE_HOST_RUSTC
	help
	  A memory-safe Rust CLI launcher for GLK-based interactive fiction
	  interpreters. Automatically detects game file formats and launches
	  the appropriate interpreter from the glkterm package.

	  https://github.com/benklop/glkcli

comment "glkcli needs glkterm, a toolchain w/ C++, threads, wchar"
	depends on !BR2_PACKAGE_GLKTERM || !BR2_INSTALL_LIBSTDCPP || \
		!BR2_TOOLCHAIN_HAS_THREADS || !BR2_USE_WCHAR
```

## base/buildroot/package/glkterm/Config.in
```kconfig
config BR2_PACKAGE_GLKTERM
    bool "glkterm"
    select BR2_PACKAGE_NCURSES
    select BR2_PACKAGE_ZLIB_NG
    select BR2_PACKAGE_SDL2
    select BR2_PACKAGE_SDL2_MIXER

    help
      GLKTerm is an interpreter for interactive fiction games on the console.

if BR2_PACKAGE_GLKTERM

menu "Interpreters for GLKTerm"

config BR2_PACKAGE_GLKTERM_ADVSYS
    bool "advsys"

config BR2_PACKAGE_GLKTERM_AGILITY
    bool "agility"

config BR2_PACKAGE_GLKTERM_ALAN2
    bool "alan2"

config BR2_PACKAGE_GLKTERM_ALAN3
    bool "alan3"

config BR2_PACKAGE_GLKTERM_BOCFEL
    bool "bocfel"

    config BR2_PACKAGE_GLKTERM_GLULXE
      bool "glulxe"

    config BR2_PACKAGE_GLKTERM_GIT
      bool "git"

    config BR2_PACKAGE_GLKTERM_HUGO
      bool "hugo"

    config BR2_PACKAGE_GLKTERM_JACL
      bool "jacl"

    config BR2_PACKAGE_GLKTERM_LEVEL9
      bool "level9"

    config BR2_PACKAGE_GLKTERM_MAGNETIC
      bool "magnetic"

    config BR2_PACKAGE_GLKTERM_PLUS
      bool "plus"

    config BR2_PACKAGE_GLKTERM_SCARE
      bool "scare"

    config BR2_PACKAGE_GLKTERM_SCOTT
      bool "scott"

    config BR2_PACKAGE_GLKTERM_TADS
      bool "tads"

    config BR2_PACKAGE_GLKTERM_TAYLOR
      bool "taylor"

endmenu

endif
```

## base/buildroot/package/kiwix-tools/Config.in
```kconfig
config BR2_PACKAGE_KIWIX_TOOLS
	bool "kiwix-tools"
	depends on BR2_INSTALL_LIBSTDCPP
	depends on BR2_TOOLCHAIN_HAS_THREADS
	select BR2_PACKAGE_LIBZIM
	select BR2_PACKAGE_LIBKIWIX
	select BR2_PACKAGE_DOCOPT_CPP
	help
	  Kiwix tools is a collection of Kiwix related command line tools:
	  - kiwix-manage: Manage XML based library of ZIM files
	  - kiwix-search: Full text search in ZIM files
	  - kiwix-serve: HTTP daemon serving ZIM files

	  All dependencies are now available and the package should build
	  successfully.

	  https://github.com/kiwix/kiwix-tools

comment "kiwix-tools needs a toolchain w/ C++, threads"
	depends on !BR2_INSTALL_LIBSTDCPP || !BR2_TOOLCHAIN_HAS_THREADS
```

## base/buildroot/package/libgc/Config.in
```kconfig
config BR2_PACKAGE_LIBGC
	bool "libgc"
	default y
	select BR2_PACKAGE_LIBATOMIC_OPS
	help
	  Garbage collector library
```

## base/buildroot/package/libkiwix/Config.in
```kconfig
config BR2_PACKAGE_LIBKIWIX
	bool "libkiwix"
	depends on BR2_INSTALL_LIBSTDCPP
	depends on BR2_TOOLCHAIN_HAS_THREADS
	select BR2_PACKAGE_LIBZIM
	select BR2_PACKAGE_LIBZIM_XAPIAN  # libkiwix requires xapian support in libzim
	select BR2_PACKAGE_ICU
	select BR2_PACKAGE_PUGIXML
	select BR2_PACKAGE_LIBCURL
	select BR2_PACKAGE_LIBMICROHTTPD
	select BR2_PACKAGE_ZLIB
	select BR2_PACKAGE_XAPIAN
	help
	  The Libkiwix provides the Kiwix software suite core. It contains
	  the code shared by all Kiwix ports (Windows, GNU/Linux, macOS,
	  Android, iOS, ...).

	  Note: This package includes the mustache.hpp header file needed
	  for templating functionality.

	  https://github.com/kiwix/libkiwix

comment "libkiwix needs a toolchain w/ C++, threads"
	depends on !BR2_INSTALL_LIBSTDCPP || !BR2_TOOLCHAIN_HAS_THREADS
```

## base/buildroot/package/libzim/Config.in
```kconfig
config BR2_PACKAGE_LIBZIM
	bool "libzim"
	depends on BR2_INSTALL_LIBSTDCPP
	depends on BR2_TOOLCHAIN_HAS_THREADS
	select BR2_PACKAGE_XZ
	select BR2_PACKAGE_ZSTD
	help
	  The Libzim is the reference implementation for the ZIM file format.
	  It's a software library to read and write ZIM files on many systems
	  and architectures.

	  https://github.com/openzim/libzim

if BR2_PACKAGE_LIBZIM

config BR2_PACKAGE_LIBZIM_XAPIAN
	bool "enable xapian search support"
	select BR2_PACKAGE_XAPIAN
	select BR2_PACKAGE_ICU
	help
	  Enable full-text search support using Xapian.
	  This adds search capabilities but increases size.

endif

comment "libzim needs a toolchain w/ C++, threads"
	depends on !BR2_INSTALL_LIBSTDCPP || !BR2_TOOLCHAIN_HAS_THREADS
```

## base/buildroot/package/load-modules/Config.in
```kconfig
config BR2_PACKAGE_LOAD_MODULES
	bool "load-modules"
	help
	  Module auto-loading infrastructure for init scripts.
	  
	  Provides a system for automatically loading kernel modules
	  during boot based on configuration in /etc/sysconfig/modules.
	  
	  Includes:
	  - S02modules init script for automatic module loading
	  - /etc/sysconfig/functions library for boot messaging
	  - /etc/sysconfig/modules configuration file

if BR2_PACKAGE_LOAD_MODULES

config BR2_PACKAGE_LOAD_MODULES_LIST
	string "List of modules to load at boot"
	default ""
	help
	  Space-separated list of kernel modules to load at boot time.
	  Each module name will be placed on a separate line in the
	  modules file. Module parameters are not supported in this
	  configuration - use the modules file directly for complex
	  module configurations.
	  
	  Examples:
	  - "rtl8188fu snd-soc-dummy"
	  - "rtl8188fu snd-soc-dummy i2c-dev"
	  
	  For modules with parameters, leave this empty and manually
	  configure /etc/sysconfig/modules on the target system.
	  
	  Leave empty to create an empty modules file that can be
	  manually configured later.

endif
```

## base/buildroot/package/perl-curses-ui/Config.in
```kconfig
config BR2_PACKAGE_PERL_CURSES_UI
	bool "perl-curses-ui"
	depends on BR2_PACKAGE_PERL
	select BR2_PACKAGE_PERL_CURSES
	help
	  A curses based OO user interface framework for Perl.
	  
	  https://metacpan.org/pod/Curses::UI
```

## base/buildroot/package/perl-curses/Config.in
```kconfig
config BR2_PACKAGE_PERL_CURSES
	bool "perl-curses"
	depends on BR2_PACKAGE_PERL
	select BR2_PACKAGE_NCURSES
	help
	  Perl bindings for the curses library.
	  
	  https://metacpan.org/pod/Curses
```

## base/buildroot/package/perl-expect/Config.in
```kconfig
config BR2_PACKAGE_PERL_EXPECT
	bool "perl-expect"
	depends on BR2_PACKAGE_PERL
	help
	  Expect for Perl - Automate interactive programs.
	  
	  https://metacpan.org/pod/Expect
```

## base/buildroot/package/perl-io-tty/Config.in
```kconfig
config BR2_PACKAGE_PERL_IO_TTY
	bool "perl-io-tty"
	help
	  Interface to Unix tty ioctls (Pseudo-TTY pty forking).

	  This provides an interface to the POSIX functions setsid(),
	  setpgid(), tcgetpgrp(), tcsetpgrp(), and to the BSD functions
	  getpt(), openpty(), forkpty(), ptsname() and the like.

	  https://metacpan.org/pod/IO::Tty
```

## base/buildroot/package/perl-term-readkey/Config.in
```kconfig
config BR2_PACKAGE_PERL_TERM_READKEY
	bool "perl-term-readkey"
	depends on BR2_PACKAGE_PERL
	select BR2_PACKAGE_HOST_QEMU
	select BR2_PACKAGE_HOST_QEMU_USER_MODE
	help
	  A perl module for simple terminal control.
	  
	  https://metacpan.org/pod/Term::ReadKey
```

## base/buildroot/package/python-sympy/Config.in
```kconfig
config BR2_PACKAGE_PYTHON_SYMPY
	bool "python-sympy"
        select BR2_PACKAGE_PYTHON_MPMATH
	help
          A computer algebra system written in pure Python 

          https://sympy.org/
```
